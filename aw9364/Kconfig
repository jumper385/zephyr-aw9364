## aw9364/Kconfig
```kconfig
# Copyright (c) 2022 XiNGRZ
# SPDX-License-Identifier: Apache-2.0

config AW9364
	bool "AW9364 LED driver"
	depends on (GPIO && LED)
	help
	  Enable LED driver for AW9364
```

## aw9364/dts/bindings/awinic,aw9364.yaml
```yaml
# Copyright (c) 2022 XiNGRZ
# SPDX-License-Identifier: Apache-2.0

description: Awinic AW9364 LED driver

compatible: "awinic,aw9364"

include: base.yaml

properties:
  output-gpios:
    type: phandle-array
    required: true

  steps:
    type: int
    required: false
    description: Number of steps supported by the LED driver (default 16)
```

## west.yml
```yaml
manifest:
  self:
    # This repository should be cloned to
    path: zephyr-aw9364
```
